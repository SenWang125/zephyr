## arch/c7x/Kconfig
```kconfig
# Copyright (c) 2026 Texas Instruments Incorporated
# SPDX-License-Identifier: Apache-2.0

config ARCH
	string
	default "c7x" if C7X

if C7X

config CPU_C7504
	bool
	select CPU_HAS_MMU
	select MMU
	help
	  This option signifies the use of a C7504 (C7x256v) DSP core.
	  Found in AM62A/D SoC.

config CPU_C7524
	bool
	select CPU_HAS_MMU
	select MMU
	help
	  This option signifies the use of a C7524 (C7x256v) DSP core.
	  Found in AM275, AM67A and J722 variant SoC. The core has the
	  internal lookup table and histogram accelerator.

config C7X_SOC_SYSTEM_HALT_HOOK
	bool
	help
	  The SoC provides z_soc_system_halt_hook(), which arch_system_halt()
	  calls with interrupts locked before the core powers off.

menu "C7x Architecture Options"

config C7X_DBG_TRACE
	bool "Exception debug trace"
	help
	  The reset and NME vectors record a trace and the faulting RP in
	  z_c7x_dbg_trace before halting. Without this the vectors record
	  nothing when halted.

config C7X_L1D_WRITE_THROUGH
	bool "L1D write-through"
	help
	  Run the L1D data cache write-through. Otherwise it is write-back.

config C7X_ILUT
	bool "Internal lookup table and histogram"
	default y
	depends on CPU_C7524
	help
	  Permit the internal lookup table and histogram instructions. They
	  are disallowed out of reset and raise an exception until the enable
	  register is written.

config C7X_I2528_WORKAROUND
	bool "Work around silicon errata i2528"
	default y
	depends on CPU_C7504 || CPU_C7524
	help
	  The MMU can misclassify the load/store category of an instruction
	  while checking memory permissions, so a valid access to a read-only
	  page may be flagged or allowed an illegal store to one. The compiler
	  avoids the affected sequences by default. If no memory page is
	  configured read-only, the workaround is not needed and can be
	  disabled.

config C7X_I2087_WORKAROUND
	bool "Work around silicon errata i2087"
	default y
	depends on CPU_C7504 || CPU_C7524
	help
	  After power-on the MMA can report errors in the HWA_STATUS
	  FirstErrorCode and LastErrorCode fields until it has been opened
	  with a state machine reset. The SW workaround manually resets MMA
	  once during early init. It is not needed when nothing reads
	  HWA_STATUS.

endmenu

endif # C7X
```

## boards/ti/am62d_evm/Kconfig.am62d_evm
```kconfig
# Copyright (c) 2025-2026 Texas Instruments Incorporated
# SPDX-License-Identifier: Apache-2.0

config BOARD_AM62D_EVM
	select SOC_AM62D2_C71_0 if BOARD_AM62D_EVM_AM62D2_C71_0
```

## boards/ti/am62d_evm/Kconfig.defconfig
```kconfig
# Copyright (c) 2025-2026 Texas Instruments Incorporated
# SPDX-License-Identifier: Apache-2.0

if BOARD_AM62D_EVM

config MBOX
	default y

config IPC_SERVICE
	default y

config OPENAMP
	default y

config HEAP_MEM_POOL_SIZE
	default 4096

endif # BOARD_AM62D_EVM
```

## boards/ti/am62d_evm/am62d_evm_am62d2_c71_0_defconfig
```kconfig
# Copyright (c) 2025-2026 Texas Instruments Incorporated
# SPDX-License-Identifier: Apache-2.0

CONFIG_PM_DEVICE=y
```

## boards/ti/am62d_evm/board.yml
```yaml
# Copyright (c) 2025-2026 Texas Instruments Incorporated
# SPDX-License-Identifier: Apache-2.0

board:
  name: am62d_evm
  full_name: AM62D2 EVM
  vendor: ti
  socs:
    - name: am62d2
```

## cmake/toolchain/cl7x/Kconfig
```kconfig
# Copyright (c) 2025 Texas Instruments Incorporated
# SPDX-License-Identifier: Apache-2.0

config LD_LINKER_SCRIPT_SUPPORTED
	default n

config CMAKE_LINKER_GENERATOR_SUPPORTED
	default y

choice LINKER_SCRIPT
	default CMAKE_LINKER_GENERATOR
endchoice
```

## drivers/dai/ti/mcasp/Kconfig.mcasp
```kconfig
#  Copyright (c) 2026 Texas Instruments Incorporated
#  SPDX-License-Identifier: Apache-2.0

config DAI_TI_MCASP
	bool "TI McASP (Multichannel Audio Serial Port) DAI driver"
	default y
	depends on DT_HAS_TI_AM62DX_MCASP_ENABLED
	help
	  Select this to enable the TI McASP DAI driver (AM62D family).
```

## drivers/interrupt_controller/Kconfig.ti_c7x_clec
```kconfig
# Copyright (c) 2026 Texas Instruments Incorporated
# SPDX-License-Identifier: Apache-2.0

config TI_C7X_CLEC
	bool "TI C7x CLEC interrupt controller driver"
	default y
	depends on DT_HAS_TI_C7X_CLEC_ENABLED
	help
	  Driver for the C7x Compute-cluster Local Event Controller (CLEC),
	  which maps K3 system-level events onto the C7x core's 64 internal
	  event lines. Every hardware interrupt on the C7x arrives through it.
```

## drivers/mbox/Kconfig.ti_omap_c7x
```kconfig
# Copyright (c) 2026 Texas Instruments Incorporated
# SPDX-License-Identifier: Apache-2.0

config MBOX_TI_OMAP_C7X
	bool "TI OMAP HW mailbox (C7x)"
	default y
	depends on MBOX
	depends on DT_HAS_TI_OMAP_MAILBOX_C7X_ENABLED
	select DYNAMIC_INTERRUPTS
	help
	  TI OMAP-style hardware mailbox driver for a C7x DSP, receiving on the
	  CLEC interrupt named in devicetree.
```

## drivers/mbox/Kconfig.ti_secproxy
```kconfig
# Copyright 2025 Texas Instruments Incorporated.
# SPDX-License-Identifier: Apache-2.0

config MBOX_TI_SECURE_PROXY
	bool "TI Secureproxy Mailbox driver"
	default y
	depends on DT_HAS_TI_SECURE_PROXY_ENABLED
	help
	  Driver for TI Secure Proxy Mailbox.

if MBOX_TI_SECURE_PROXY

config MBOX_TI_SECPROXY_POLL
	bool "Poll RX threads that have no interrupt"
	help
	  Receive on channels whose DT node declares no matching rx_<n>
	  interrupt by polling the thread status from a driver thread instead
	  of returning -EINVAL from mbox_set_enabled().

	  Needed on hosts that own secure-proxy threads but get no interrupt
	  route to them.

config MBOX_TI_SECPROXY_POLL_INTERVAL_MS
	int "Poll interval (ms)"
	default 1
	depends on MBOX_TI_SECPROXY_POLL
	help
	  Bounds how long a response sits unread. Transfers are infrequent and
	  synchronous, so this mostly sets their latency floor.

config MBOX_TI_SECPROXY_POLL_PRIORITY
	int "Poll thread priority"
	default 0
	depends on MBOX_TI_SECPROXY_POLL
	help
	  Must outrank any thread that blocks waiting on a response, or the
	  reply cannot be collected until that thread yields.

config MBOX_TI_SECPROXY_POLL_STACK_SIZE
	int "Poll thread stack size"
	default 1024
	depends on MBOX_TI_SECPROXY_POLL

endif # MBOX_TI_SECURE_PROXY
```

## drivers/timer/Kconfig.ti_dmtimer_c7x
```kconfig
# Copyright (c) 2026 Texas Instruments Incorporated
# SPDX-License-Identifier: Apache-2.0

config TI_DMTIMER_C7X
	bool "TI DMTimer system clock driver for C7x"
	depends on SOC_FAMILY_TI_K3_C7X && DT_HAS_TI_AM654_TIMER_ENABLED
	select TIMER_HAS_64BIT_CYCLE_COUNTER
	help
	  System clock from a K3 DMTimer routed to the C7x through the CLEC,
	  with cycles counted by the C7x time stamp counter.

config TI_DMTIMER_C7X_CLOCK_HZ
	int "DMTimer input clock rate (Hz)"
	depends on TI_DMTIMER_C7X
	default 25000000
	help
	  Rate of the DMTimer functional clock, 25 MHz (MCU_HFOSC0) by
	  default. A board with another input clock overrides this here;
	  the ti,am654-timer binding declares no clock-frequency property.
```

## dts/bindings/cpu/ti,c7x.yaml
```yaml
# Copyright (c) 2026 Texas Instruments Incorporated
# SPDX-License-Identifier: Apache-2.0

description: TI C7x DSP CPU

compatible: "ti,c7x"

include: cpu.yaml

properties:
  reg:
    required: true
    description: The cluster field of the core's DNUM register, bits 23:16
```

## dts/bindings/dai/ti,am62dx-mcasp.yaml
```yaml
# Copyright (c) 2026 Texas Instruments Incorporated
# SPDX-License-Identifier: Apache-2.0

description: |
  TI McASP as a DAI, the Linux davinci-mcasp binding
  (Documentation/devicetree/bindings/sound/davinci-mcasp-audio.yaml) property
  for property. Precedence, highest first:

    1. the simple-audio-card dai-link whose cpu is this node, per direction
       (playback-only / capture-only links, as on the AM62D EVM): format, clock
       and frame-sync provider, bit-clock and frame inversion, and on its cpu
       end dai-tdm-slot-num / dai-tdm-slot-width (snd_soc_of_parse_tdm_slot);
    2. this node, board .dts over SoC .dtsi (op-mode, tdm-slots, tdm-slots-rx,
       serial-dir, ti,async-mode, tx/rx-num-evt, dismod, clocks);
    3. the stream: the IPC4 copier blob's tdm slots and slot width, then the
       sample width;
    4. the driver defaults, which are davinci-mcasp's: AFIFO off when
       tx/rx-num-evt is absent, DISMOD drive-low, dsp_a with normal clocks and
       the McASP providing both clocks.

  Nothing about the wire is a literal in the driver.

compatible: "ti,am62dx-mcasp"

include: base.yaml

properties:
  reg:
    required: true

  reg-names:
    required: true
    description: '"mpu" (control registers) and "dat" (data port).'

  interrupts:
    description: |
      TX and RX interrupts through the CLEC, <event irq priority flags> each.
      The AM62 McASP2 lines are GIC SPI 240 (tx) and 239 (rx); the CLEC input is
      the SPI number plus 256.

  interrupt-names:
    description: '"tx", "rx", exactly as the Linux node.'

  op-mode:
    type: int
    enum: [0, 1]
    description: 0 = I2S/TDM, 1 = DIT. Only 0 is implemented.

  tdm-slots:
    type: int
    description: TX slots per frame (RX too unless tdm-slots-rx is given).

  tdm-slots-rx:
    type: int
    description: RX slots per frame; needs ti,async-mode.

  ti,async-mode:
    type: boolean
    description: |
      TX and RX run on their own clocks and frame syncs (ACLKXCTL.ASYNC = 1).
      Absent = synchronous, RX slaves to the TX clock.

  serial-dir:
    type: array
    required: true
    description: |
      Per-serializer direction, one entry per serializer, exactly as the
      Linux binding: 0 = inactive, 1 = TX, 2 = RX.

  tx-num-evt:
    type: int
    description: |
      TX AFIFO event threshold (WNUMEVT, 32-bit words). 0 or absent = AFIFO
      off, as davinci-mcasp. The TI RTOS SDK default is 32.

  rx-num-evt:
    type: int
    description: |
      RX AFIFO event threshold (RNUMEVT, 32-bit words). 0 or absent = AFIFO
      off, as davinci-mcasp. The TI RTOS SDK default is 32.

  dismod:
    type: int
    enum: [0, 2, 3]
    description: |
      What a serializer drives while it is not transmitting, exactly as the
      Linux binding: 0 = three-state, 2 = drive low, 3 = drive high.
      Absent = 2, davinci-mcasp's default.

  dmas:
    type: phandle-array
    description: TX/RX DMA (BCDMA PDMA thread specifier, as on Linux).

  dma-names:
    type: string-array
    description: '"tx", "rx".'

  clocks:
    description: |
      Functional/AUX clock as a TI-SCI <devid clkid> specifier, the same k3_clks
      phandle the Linux node carries; applied at probe with the assigned-clock
      properties below.

  assigned-clocks:
    type: phandle-array
    specifier-space: clock
    description: Clock to configure at probe (Linux assigned-clocks shape).

  assigned-clock-parents:
    type: phandle-array
    specifier-space: clock
    description: Parent for assigned-clocks[0] (clkid cell = parent index).

  assigned-clock-rates:
    type: array
    description: Rate in Hz for assigned-clocks[0].

  "#sound-dai-cells":
    type: int
    const: 0
```

## dts/bindings/dma/ti,am64-dmss-bcdma.yaml
```yaml
# Copyright (c) 2026 Texas Instruments Incorporated
# SPDX-License-Identifier: Apache-2.0

description: |
  TI K3 DMSS BCDMA (Block-Copy DMA) controller.

  Node/specifier-compatible with the Linux ti,am64-dmss-bcdma binding
  (k3-am62a-main.dtsi main_bcdma): the same customer devicetree configures
  both OSes. Specifier: <type thread-id atype> (type 0 = split-TR channel
  paired to a PDMA thread, e.g. McASP2 TX = 0xc502).

compatible: "ti,am64-dmss-bcdma"

include: base.yaml

properties:
  reg:
    required: true
  reg-names:
    required: true
  "#dma-cells":
    type: int
    required: true
    const: 3
  ti,sci-dev-id:
    type: int
    description: TISCI device id of the DMSS (26 on AM62x).

dma-cells:
  - type
  - thread-id
  - atype
```

## dts/bindings/dma/ti,c7x-dru.yaml
```yaml
# Copyright (c) 2026 Texas Instruments Incorporated
# SPDX-License-Identifier: Apache-2.0

description: |
  TI C7x Data Routing Unit (DRU), the UTC DMA inside the C7x compute cluster.
  The only DMA on this SoC that can reach L2SRAM. Programmed with AutoInc3d
  Transfer Requests; completion is signalled as a C7x event via CLEC.

compatible: "ti,c7x-dru"

include: dma-controller.yaml

properties:
  reg:
    required: true
    description: DRU register block and the CLEC block that routes its events.

  reg-names:
    required: true

  ti,c7x-event:
    type: int
    required: true
    description: C7x event number the DRU completion is routed to (EFR bit).

  ti,local-event-start:
    type: int
    required: true
    description: CLEC input index of DRU channel 0.

  ti,handshake-region:
    type: phandle
    description: |
      Non-cached memory the host uses to request a selftest or the offload
      and to read the DRU statistics.

  memory-regions:
    type: phandles
    description: |
      Regions the DRU may use as a transfer endpoint. Anything outside them is
      refused: a TR on Linux-owned memory took the host down twice.

  "#dma-cells":
    const: 0
```

## dts/bindings/interrupt-controller/ti,c7x-clec.yaml
```yaml
# Copyright (c) 2026 Texas Instruments Incorporated
# SPDX-License-Identifier: Apache-2.0

title: TI C7x CLEC

description: |
  Compute-cluster Local Event Controller of a TI C7x DSP. It routes SoC-level
  events onto the core's internal event lines through one 32-bit MRR (Mux
  Routing Register) per input event, at CLEC_BASE + 0x80000 + event * 0x100.

  Interrupt specifier: <event irq priority flags>
    event    : CLEC input event index (GIC SPI family inputs sit at +256)
    irq      : C7x internal event line, 0-63; the number the kernel uses
    priority : C7x event priority programmed into the MRR
    flags    : C7X_CLEC_LEVEL or C7X_CLEC_EDGE (dt-bindings/interrupt-controller/ti-c7x-clec.h)

  Every node that names this controller as its interrupt parent has its
  route programmed by the driver; there is no separate routing table.

compatible: "ti,c7x-clec"

include: base.yaml

properties:
  reg:
    required: true

  "#interrupt-cells":
    type: int
    const: 4

  ti,num-events:
    type: int
    description: Number of CLEC input event slots (512 on C7x256v).

  ti,num-c7x-events:
    type: int
    description: Number of C7x internal event lines (64).

interrupt-cells:
  - event
  - irq
  - priority
  - flags
```

## dts/bindings/mbox/ti,omap-mailbox-c7x.yaml
```yaml
# Copyright (c) 2026 Texas Instruments Incorporated
# SPDX-License-Identifier: Apache-2.0

title: TI OMAP mailbox, C7x side

description: |
  TI HW mailbox (OMAP-style) as seen by the C7x DSP. One fifo carries
  C7x->host kicks, the next carries host->C7x kicks; the message is the
  caller's 32-bit payload, or 0 for a NULL doorbell, as in ti,omap-mailbox.
  Rx is polled unless CONFIG_MBOX_TI_OMAP_C7X_IRQ takes the interrupt named
  here.

compatible: "ti,omap-mailbox-c7x"

include: [base.yaml, mailbox-controller.yaml]

properties:
  reg:
    required: true

  interrupts:
    description: CLEC route of the host->C7x fifo's new-message event.


mbox-cells:
  - channel
```

## dts/bindings/sram/ti,c7x-mmu-region.yaml
```yaml
# Copyright (c) 2026 Texas Instruments Incorporated
# SPDX-License-Identifier: Apache-2.0

description: |
  A physical memory window the TI C7x maps at the same virtual address, with
  the cacheability given by zephyr,memory-attr (DT_MEM_CACHEABLE or not).

compatible: "ti,c7x-mmu-region"

include: [base.yaml, "zephyr,memory-common.yaml"]

properties:
  reg:
    required: true

  zephyr,memory-attr:
    required: true
```

## samples/subsys/ipc/openamp_rsc_table/Kconfig
```kconfig
# Copyright (c) 2026 Texas Instruments Incorporated
# SPDX-License-Identifier: Apache-2.0

mainmenu "OpenAMP resource table sample"

config APP_TASK_STACK_SIZE
	int "Stack size of the manager and client threads"
	default 1024
	help
	  A core that saves a large register file on a call needs more than
	  the default.

config APP_TTY_TASK_STACK_SIZE
	int "Stack size of the TTY thread"
	default 1536

source "Kconfig.zephyr"
```
