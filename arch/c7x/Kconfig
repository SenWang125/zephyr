## soc/ti/k3/Kconfig
```kconfig
# Copyright (c) 2023 Enphase Energy
# Copyright (c) 2024 Nordic Semiconductor ASA
# Copyright (c) 2026 Siemens Mobility GmbH
# SPDX-License-Identifier: Apache-2.0

if SOC_FAMILY_TI_K3

rsource "*/Kconfig"

config SOC_PART_NUMBER
	default "AM2434" if SOC_AM2434_M4 || SOC_AM2434_R5F0_0
	default "AM6232" if SOC_AM6232_A53 || SOC_AM6232_M4
	default "AM6234" if SOC_AM6234_A53 || SOC_AM6234_M4
	default "AM6254" if SOC_AM6254_A53 || SOC_AM6254_M4
	default "AM62D2" if SOC_AM62D2_C71_0
	default "AM62L3" if SOC_AM62L3_A53
	default "AM6442" if SOC_AM6442_M4 || SOC_AM6442_R5F0_0 || SOC_AM6442_R5F0_1 || SOC_AM6442_R5F1_0 || SOC_AM6442_R5F1_1
	default "J721e" if SOC_J721E_MAIN_R5F0_0 || SOC_J721E_MAIN_R5F0_1 || \
		SOC_J721E_MAIN_R5F1_0 || SOC_J721E_MAIN_R5F1_1 || \
		SOC_J721E_MCU_R5F0_0 || SOC_J721E_MCU_R5F0_1

config SOC_FAMILY_TI_K3_BOOT_SPRINGBOARD
	def_bool ($(dt_chosen_reg_addr_hex,$(DT_CHOSEN_Z_SRAM)) >= 0x80000000)
	depends on SOC_SERIES_AM64X_R5 || SOC_SERIES_J721E_R5 || SOC_SERIES_J722S_R5
	help
	  If Zephyr code area is in DRAM which is MPU protected from execution
	  by default then this option enables a boot springboard in ATCM to set
	  executable permissions before jumping to the code area in DRAM

DT_CHOSEN_Z_IPC := zephyr,ipc

config SOC_FAMILY_TI_K3_C7X_FATAL_SHUTDOWN_ACK
	bool "Answer the remoteproc shutdown request after a fatal error"
	default y
	depends on SOC_FAMILY_TI_K3_C7X
	depends on MBOX_TI_OMAP_C7X && POWEROFF
	depends on $(dt_chosen_enabled,$(DT_CHOSEN_Z_IPC))
	select C7X_SOC_SYSTEM_HALT
	help
	  After a fatal error the core polls the "rx" mailbox channel of the
	  zephyr,ipc node for the remoteproc shutdown request, acknowledges it
	  on the "tx" channel and powers off. The host can then stop the core
	  and load a new image.

endif # SOC_FAMILY_TI_K3
```

## soc/ti/k3/j722s/Kconfig.soc
```kconfig
# Copyright (c) 2023 Enphase Energy
# Copyright (c) 2026 Siemens Mobility GmbH
# SPDX-License-Identifier: Apache-2.0

config SOC_SERIES_J722S
	bool
	select SOC_FAMILY_TI_K3

config SOC_SERIES_J722S_R5
	bool
	select SOC_SERIES_J722S
	help
	  Enable support for J722S R5 Series.

config SOC_J722S_MAIN_R5F0_0
	bool
	select SOC_SERIES_J722S_R5

config SOC_J722S_MCU_R5F0_0
	bool
	select SOC_SERIES_J722S_R5

config SOC_SERIES_J722S_C7X
	bool
	select SOC_SERIES_J722S
	select SOC_FAMILY_TI_K3_C7X
	help
	  Enable support for J722S C7x DSP Series.

config SOC_J722S_C71_0
	bool
	select SOC_SERIES_J722S_C7X
```
